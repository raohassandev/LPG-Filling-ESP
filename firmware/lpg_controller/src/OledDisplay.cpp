#include "OledDisplay.h"

#include <Wire.h>

namespace {
constexpr uint8_t kFontBlank[5] = {0x00, 0x00, 0x00, 0x00, 0x00};
constexpr uint8_t kFontColon[5] = {0x00, 0x36, 0x36, 0x00, 0x00};
constexpr uint8_t kFontDash[5] = {0x08, 0x08, 0x08, 0x08, 0x08};
constexpr uint8_t kFontDot[5] = {0x00, 0x60, 0x60, 0x00, 0x00};
constexpr uint8_t kFontSlash[5] = {0x20, 0x10, 0x08, 0x04, 0x02};

constexpr uint8_t kDigits[10][5] = {
    {0x3E, 0x51, 0x49, 0x45, 0x3E}, {0x00, 0x42, 0x7F, 0x40, 0x00},
    {0x42, 0x61, 0x51, 0x49, 0x46}, {0x21, 0x41, 0x45, 0x4B, 0x31},
    {0x18, 0x14, 0x12, 0x7F, 0x10}, {0x27, 0x45, 0x45, 0x45, 0x39},
    {0x3C, 0x4A, 0x49, 0x49, 0x30}, {0x01, 0x71, 0x09, 0x05, 0x03},
    {0x36, 0x49, 0x49, 0x49, 0x36}, {0x06, 0x49, 0x49, 0x29, 0x1E}};

constexpr uint8_t kLetters[26][5] = {
    {0x7E, 0x11, 0x11, 0x11, 0x7E}, {0x7F, 0x49, 0x49, 0x49, 0x36},
    {0x3E, 0x41, 0x41, 0x41, 0x22}, {0x7F, 0x41, 0x41, 0x22, 0x1C},
    {0x7F, 0x49, 0x49, 0x49, 0x41}, {0x7F, 0x09, 0x09, 0x09, 0x01},
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    {0x07, 0x08, 0x70, 0x08, 0x07}, {0x61, 0x51, 0x49, 0x45, 0x43}};
}

void OledDisplay::begin() {
  Wire.beginTransmission(config_.kOledAddress);
  if (Wire.endTransmission() != 0) {
    Serial.println(F("[OLED] SSD1306 not found"));
    initialized_ = false;
    return;
  }

  const uint8_t init[] = {0xAE, 0xD5, 0x80, 0xA8, 0x3F, 0xD3, 0x00, 0x40, 0x8D, 0x14, 0x20, 0x00,
                          0xA1, 0xC8, 0xDA, 0x12, 0x81, 0xCF, 0xD9, 0xF1, 0xDB, 0x40, 0xA4, 0xA6,
                          0x2E, 0xAF};
  for (uint8_t value : init) {
    command(value);
  }

  initialized_ = true;
  clear();
  Serial.println(F("[OLED] SSD1306 initialized"));
}

void OledDisplay::clear() {
  memset(buffer_, 0, sizeof(buffer_));
  flush();
}

void OledDisplay::showLines(const String& line1, const String& line2, const String& line3, const String& line4) {
  if (!initialized_) {
    return;
  }

  memset(buffer_, 0, sizeof(buffer_));
  drawText(0, line1);
  drawText(2, line2);
  drawText(4, line3);
  drawText(6, line4);
  flush();
}

void OledDisplay::command(uint8_t value) {
  Wire.beginTransmission(config_.kOledAddress);
  Wire.write(0x00);
  Wire.write(value);
  Wire.endTransmission();
}

void OledDisplay::flush() {
  if (!initialized_) {
    return;
  }

  command(0x21);
  command(0);
  command(127);
  command(0x22);
  command(0);
  command(7);

  for (uint16_t offset = 0; offset < sizeof(buffer_); offset += 16) {
    Wire.beginTransmission(config_.kOledAddress);
    Wire.write(0x40);
    for (uint8_t i = 0; i < 16; ++i) {
      Wire.write(buffer_[offset + i]);
    }
    Wire.endTransmission();
  }
}

void OledDisplay::drawText(uint8_t row, const String& text) {
  const uint8_t page = row > 7 ? 7 : row;
  const uint8_t maxChars = 21;
  for (uint8_t i = 0; i < text.length() && i < maxChars; ++i) {
    drawChar(i * 6, page, text.charAt(i));
  }
}

void OledDisplay::drawChar(uint8_t x, uint8_t page, char c) {
  const uint8_t* data = glyph(c);
  const uint16_t base = page * 128 + x;
  for (uint8_t i = 0; i < 5 && x + i < 128; ++i) {
    buffer_[base + i] = data[i];
  }
}

const uint8_t* OledDisplay::glyph(char c) const {
  if (c >= 'a' && c <= 'z') {
    c = c - 'a' + 'A';
  }
  if (c >= '0' && c <= '9') {
    return kDigits[c - '0'];
  }
  if (c >= 'A' && c <= 'Z') {
    return kLetters[c - 'A'];
  }
  if (c == ':') {
    return kFontColon;
  }
  if (c == '-') {
    return kFontDash;
  }
  if (c == '.') {
    return kFontDot;
  }
  if (c == '/') {
    return kFontSlash;
  }
  return kFontBlank;
}
